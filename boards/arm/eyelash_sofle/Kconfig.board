## boards/arm/eyelash_sofle/Kconfig.board
```kconfig
#
# Copyright (c) 2024 The ZMK Contributors
# SPDX-License-Identifier: MIT
#

config BOARD_EYELASH_SOFLE_LEFT
    bool "eyelash_sofle left"
    depends on SOC_NRF52840_QIAA

config BOARD_EYELASH_SOFLE_RIGHT
    bool "eyelash_sofle right"
    depends on SOC_NRF52840_QIAA


menu "Tap Settings"

config ZMK_TAPPING_TERM
    int "Tapping Term"
    default 200

config ZMK_TAP_PREFERRED
    bool "Tap Preferred"
    default n

config ZMK_PERMISSIVE_HOLD
    bool "Permissive Hold"
    default n

config ZMK_IGNORE_MOD_TAP_INTERRUPT
    bool "Ignore Mod Tap Interrupt"
    default n

config ZMK_TAP_HOLD_THRESHOLD
    int "Tap Hold Threshold"
    default 50

endmenu
```
